## config/Kconfig
```kconfig
# ドライバの設定を直接定義します
config PMW3610
    bool "PMW3610 Driver"
    default y
    help
      Enable PMW3610 mouse sensor driver.

if PMW3610
    config PMW3610_CPI
        int "Default CPI"
        default 1200
endif
```

## config/boards/shields/crosses/Kconfig.defconfig
```kconfig
if SHIELD_CROSSES_LEFT || SHIELD_CROSSES_RIGHT

config ZMK_KEYBOARD_NAME
    default "Crosses"

endif
```

## config/drivers/sensor/pmw3610/Kconfig
```kconfig
config PMW3610
    bool "PMW3610 Driver"
    default y
    help
      Enable PMW3610 mouse sensor driver.

if PMW3610
    config PMW3610_CPI
        int "Default CPI"
        default 1200
    config PMW3610_SMART_ALGORITHM
        bool "Enable smart algorithm"
        default y
endif
```

## config/dts/bindings/sensor/pixart,pmw3610.yaml
```yaml
description: "PixArt PMW3610 optical mouse sensor"

compatible: "pixart,pmw3610"

include: spi-device.yaml

on-bus: spi

properties:
    motion-gpios:
      type: phandle-array
      required: true
      description: "Motion interrupt GPIO pin"
      
    "zephyr,axis-x":
      type: int
      required: false
      default: 0
      description: "Axis X mapping (0: X, 1: Y, etc)"

    "zephyr,axis-y":
      type: int
      required: false
      default: 1
      description: "Axis Y mapping"
```

## config/dts/bindings/vendor-prefixes.yaml
```yaml
description: Vendor prefixes
compatible: "vnd,vendor-prefixes"
properties:
  pixart:
    description: PixArt Imaging Inc.
```

## config/west.yml
```yaml
manifest:
  remotes:
    - name: zmkfirmware
      url-base: https://github.com/zmkfirmware
    - name: urob
      url-base: https://github.com/urob
  projects:
    - name: zmk
      remote: urob
      revision: main
      import: app/west.yml
    - name: zmk-pmw3610-driver
      url: https://github.com/badjeff/zmk-pmw3610-driver
      revision: main
      # ★この行を必ず入れてください！これがないとZMKが認識しません★
      path: modules/drivers/zmk-pmw3610-driver
  self:
    path: config
```
